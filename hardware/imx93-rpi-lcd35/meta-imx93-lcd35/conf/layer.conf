## hardware/imx93-rpi-lcd35/meta-imx93-lcd35/conf/layer.conf
```bitbake
BBPATH .= ":${LAYERDIR}"
BBFILES += "${LAYERDIR}/recipes-*/*/*.bb ${LAYERDIR}/recipes-*/*/*.bbappend"

BBFILE_COLLECTIONS += "imx93lcd35"
BBFILE_PATTERN_imx93lcd35 = "^${LAYERDIR}/"
BBFILE_PRIORITY_imx93lcd35 = "20"

LAYERSERIES_COMPAT_imx93lcd35 = "scarthgap"
```
